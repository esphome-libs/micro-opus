## examples/encode_benchmark/sdkconfig.defaults
```kconfig
# Disable watchdog (benchmark runs continuously)
CONFIG_ESP_TASK_WDT_EN=n
CONFIG_ESP_TASK_WDT_INIT=n

# Larger stack for encoder (uses more working memory than decoder)
CONFIG_ESP_MAIN_TASK_STACK_SIZE=16000

# Maximum CPU frequency
CONFIG_ESP_DEFAULT_CPU_FREQ_MHZ_240=y

# Performance optimization
CONFIG_COMPILER_OPTIMIZATION_PERF=y

# Enable PSRAM (octal mode for ESP32-S3)
CONFIG_SPIRAM=y
CONFIG_SPIRAM_MODE_OCT=y
CONFIG_SPIRAM_USE_CAPS_ALLOC=y
CONFIG_SPIRAM_SPEED_80M=y

# Cache optimizations for better performance
CONFIG_ESP32S3_DATA_CACHE_64KB=y
CONFIG_ESP32S3_DATA_CACHE_LINE_64B=y
CONFIG_ESP32S3_INSTRUCTION_CACHE_32KB=y

# Opus configuration - use threadsafe pseudostack
CONFIG_OPUS_THREADSAFE_PSEUDOSTACK=y

# Disable internal timing instrumentation (we do our own timing)
CONFIG_OPUS_ENABLE_CELT_TIMING=n
CONFIG_OPUS_ENABLE_PVQ_TIMING=n
CONFIG_OPUS_ENABLE_QUANT_BANDS_TIMING=n

# Use fixed-point (faster than floating-point for encoding on ESP32-S3)
CONFIG_OPUS_FLOATING_POINT=n
```

## tests/qemu/sdkconfig.defaults
```kconfig
# Test-firmware defaults, shared by the PlatformIO (local) and idf.py (CI) builds.
#
# Target is esp32s3, where CONFIG_OPUS_ENABLE_XTENSA_OPTIMIZATIONS and
# CONFIG_OPUS_FLOATING_POINT both default to y -- i.e. this firmware exercises
# exactly the Xtensa LX7 assembly + float decode paths the host suite cannot.

# Deliberately NO PSRAM: the firmware decodes one frame at a time and streams the
# raw int16 PCM straight out a dedicated UART (never buffering a whole signal), so
# the bare qemu-system-xtensa esp32s3 machine, which has no PSRAM, boots clean
# instead of aborting in cpu_start on external-RAM init.

# Generous main-task stack for the decoder's working buffers.
CONFIG_ESP_MAIN_TASK_STACK_SIZE=24576

# The firmware runs to completion and then parks in a busy loop; no watchdog.
CONFIG_ESP_TASK_WDT_EN=n
CONFIG_ESP_TASK_WDT_INIT=n

# Match the benchmark's optimization level so codegen is representative.
CONFIG_COMPILER_OPTIMIZATION_PERF=y

# Threadsafe pseudostack, matching the component default used on-device.
CONFIG_OPUS_THREADSAFE_PSEUDOSTACK=y

# 16 MB flash with a custom partition table: the embedded ".bit" vectors push the
# app image well past the default 4 MB factory partition (see partitions.csv).
CONFIG_ESPTOOLPY_FLASHSIZE_16MB=y
CONFIG_PARTITION_TABLE_CUSTOM=y
CONFIG_PARTITION_TABLE_CUSTOM_FILENAME="partitions.csv"
```
